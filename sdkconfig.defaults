## sdkconfig.defaults
```kconfig
# Enable the ESP-IDF power-management driver and FreeRTOS tickless idle.
# These are required for esp_pm_configure() to accept light_sleep_enable=true
# without printing a "light sleep is not allowed" warning.
CONFIG_PM_ENABLE=y
CONFIG_FREERTOS_USE_TICKLESS_IDLE=y

# Increase main task stack for NimBLE initialisation overhead.
CONFIG_ESP_MAIN_TASK_STACK_SIZE=8192

# Allow the HTTP server to receive large OTA firmware binaries.
CONFIG_HTTPD_MAX_REQ_HDR_LEN=1024
CONFIG_HTTPD_MAX_URI_LEN=512

# Enable Bluetooth and the NimBLE host stack (required by esp-nimble-cpp).
CONFIG_BT_ENABLED=y
CONFIG_BT_NIMBLE_ENABLED=y
```
